## drivers/sensor/drv2605/Kconfig
```kconfig
config DRV2605
	bool "DRV2605 Haptics Driver Sensor"
	default n
	depends on I2C
	help
	  Enable driver for the DRV2605 Haptics Driver Sensor.
```

## dts/bindings/sensor/ti,drv2605.yaml
```yaml
description: Texas Instruments DRV2605 haptics driver sensor

compatible: "ti,drv2605"

include: ["i2c-device.yaml", "sensor-device.yaml"]
# some notes
# i2c-device.yaml:
# contains base.yaml, power.yaml
# base.yaml contains typical properties that might be used
# power.yaml contains properties for nodes with variable power
# contains on-bus (???)
# contains the required reg property
# sensor-device.yaml:
# contains base.yaml
# contains the friendly-name property

properties:
  reg:
    required: true
    description: device address on i2c bus
  motor_type:
    type: int
    required: true
    description: |
      The type of haptic motor attached to the sensor
      0 # ERM
      1 # LRA
    enum: 
      - 0
      - 1
  motor_frequency:
    type: int
    required: true
    description: The resonance frequency of the haptic motor
  motor_voltagerms:
    type: int
    required: true
    description: |
      The voltage RMS of the haptic motor
      0 # 1.8 Vrms
      1 # 3.0 Vrms
    enum:
      - 0
      - 1
```
